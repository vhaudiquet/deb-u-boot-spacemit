// SPDX-License-Identifier: (GPL-2.0 OR MIT)
/* Copyright (c) 2022 Spacemit, Inc */

/dts-v1/;

#include "k1-pro.dtsi"
/ {
	model = "spacemit k1-pro sim board";

	memory@0 {
		device_type = "memory";
		reg = <0x0 0x20000000 0x0 0x04000000>;
	};

	chosen {
		stdout-path = &uart0;
	};
};

&uart0 {
	status = "okay";
};
