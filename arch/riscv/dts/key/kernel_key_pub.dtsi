// SPDX-License-Identifier: (GPL-2.0 OR MIT)
/* Copyright (c) 2023 Spacemit, Inc */
/ {
	signature {
			key-kernel_key_prv {
			required = "conf";
			algo = "sha256,rsa2048";
			rsa,r-squared = <0x21003b7c 0x955f10fb 0x81588eeb 0x30db7f3b 0xf17e1923 0x540599d9 0x8b040670 0xfab5a574 0x850f58a4 0x100d300a 0xc12769ab 0xb74d436f 0x632104ae 0x1033d0e2 0x1bd99b54 0xa94b04bc 0x26878f7f 0xbdd3b49 0x62f75b08 0xe45ff1cf 0x86b781d8 0x88169cf 0xf8a079f5 0xf20b984a 0x5fa53043 0x81be490 0x6e6e2c20 0x7c634d01 0x482c281c 0xa66c1c36 0x19148ba8 0xd33bc4f1 0x55ff8071 0xda5326dc 0xc4a0fa0a 0x4ee6ed86 0x1df85505 0x2046157d 0xf7c3ee7a 0x65d1a898 0x11d6fc3a 0x3e6eee66 0xb7e60fb0 0xbd294a64 0xf10592e5 0x8a124048 0xe67b8d58 0x945d6eb6 0xbdc523e2 0x3820ab31 0x90dfa8bc 0x64789961 0x185e45a4 0xf9f318fd 0x9da545c4 0x89332ce8 0x86cc387a 0x79257691 0x9404b602 0x48182170 0xaecef82a 0x1f051b48 0x1d507a62 0xfbca9b4a>;
			rsa,modulus = <0xbda61775 0x13cb76db 0x9d40708d 0x6821522f 0x2588835d 0xa9ad2bba 0x1e41a22c 0xda779700 0x4862fc32 0x2b0600b1 0x5cdd38ce 0x1f4b2564 0x8c747e6a 0xdb1fc496 0x4448626 0xc7dd7a3f 0x5e121dc5 0x36a51817 0x80b73fb5 0x3fb90440 0xc8151b4c 0xd069fee8 0xa619a441 0x48bf4bd8 0xfd1b1cbe 0xcee80bb7 0x1188ae40 0xb2fe71bd 0x38131c2b 0x3777fa40 0xea3550d6 0x483d7044 0xb983159f 0xc80c5182 0x774565c1 0xc37b64b7 0xe1e06e7a 0x264b4745 0xdc6f1e02 0x381851be 0x4bcce7e8 0x491a0496 0xec1ce45d 0xfd341909 0x83987b7b 0xc7abdfa6 0x8e1f14a9 0x6710989c 0x2de1a58e 0x621e4322 0x26056be2 0x6ef316f8 0x3481c9a2 0xf75e91e5 0xbb0c5fe9 0x184a9726 0x7febc739 0xc6e995d8 0xdb050061 0x45d6f60d 0xf475872b 0x3f1998d9 0xad99e3a3 0x91c42525>;
			rsa,exponent = <0x00000000 0x00010001>;
			rsa,n0-inverse = <0x77869153>;
			rsa,num-bits = <0x00000800>;
			key-name-hint = "kernel_key_prv";
		};
	};
};
