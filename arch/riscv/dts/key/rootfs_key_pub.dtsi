// SPDX-License-Identifier: (GPL-2.0 OR MIT)
/* Copyright (c) 2023 Spacemit, Inc */
/ {
	signature {
			key-rootfs_key_prv {
			required = "conf";
			algo = "sha256,rsa2048";
			rsa,r-squared = <0x3830d64f 0xac0aab2a 0x59927867 0x3ea983f 0x992f981e 0x2aad594e 0xdd07eeb5 0x9d2281f3 0x28662180 0xf7d1b385 0x99e4c9df 0xef21048a 0xc964e4f2 0xcbe92c21 0x884406fd 0xb970149e 0x64fe24a6 0xb2bdd895 0xb1501588 0x19a2f619 0x63839d3e 0xd2d240bb 0x958bcd9e 0x307abe4a 0x56d87082 0xcdb56191 0xf4ec71b 0xb179e955 0x9d9df848 0x513ad1bd 0xb510f012 0x44b15128 0xc67b3e19 0xb83c22ae 0x97e5253d 0x1b4f7df7 0x3f6bbfd8 0xa54ad2c0 0xb6dca9ec 0x48cbe278 0x3a976ff5 0xae3c90de 0x36356f42 0x96f0cdb0 0xed0b1fbc 0xbd4c58d7 0xe55606f8 0x9706957e 0x9a20cc62 0x87befed5 0xeb72c850 0x6f6c8cc7 0x114631c 0xe65b874a 0x27df291e 0x784df561 0x72ec1a3d 0x8e09ab77 0x52f1a9b6 0x73c53611 0x6e737fb7 0x8361d865 0xaa9c6a03 0x3441f838>;
			rsa,modulus = <0xd8778e49 0x79d40d17 0xcc85fec9 0x2bd14401 0x6855f11d 0xc1679cd2 0x9ebe0c3d 0x6e5bcbd8 0x60efa465 0x2dc92245 0x63a37a93 0x93a277a2 0x6fb86294 0xb4fbed7b 0xab721eff 0x84c6aa3b 0x2ca6c0eb 0x2f525324 0x1da744e7 0xa9cf15af 0x1e1a3167 0x9ad6e84b 0x5b6f7491 0xeb866090 0xebd2073d 0x13c81187 0xe18b130e 0x620bfe04 0x97743e14 0xc03294f4 0xf7298367 0xe948cdf8 0x16dbebe9 0xc2342f8c 0x56900650 0xabafd27c 0x9986d85e 0x71d0d6e3 0x70e82e14 0xefb265e 0x466410d4 0xa758ee1b 0x714554b1 0x52dc40a 0xf5a951f0 0x932e3f4b 0x55c480e0 0xf0e7a86b 0x24d14571 0xf7a321ca 0x249df1e0 0x1e265d3a 0xbff02432 0x850044f9 0x76244cfe 0x2ac6acba 0x1383c1e1 0x6e8acc7a 0xe1e1069f 0x6b69b313 0xcc8ad8dc 0x38670cf 0x1e690454 0x52f51743>;
			rsa,exponent = <0x00000000 0x00010001>;
			rsa,n0-inverse = <0xf5225295>;
			rsa,num-bits = <0x00000800>;
			key-name-hint = "rootfs_key_prv";
		};
	};
};
