## configs/k3_fpga_defconfig
```kconfig
CONFIG_RISCV=y
CONFIG_SYS_TEXT_BASE=0x102000000
CONFIG_SYS_MALLOC_LEN=0x800000
CONFIG_NR_DRAM_BANKS=1
CONFIG_ENV_SIZE=0x4000
CONFIG_DM_GPIO=y
CONFIG_SPL_DM_SPI=y
CONFIG_DEFAULT_DEVICE_TREE="k3_spl"
CONFIG_SPL_TEXT_BASE=0xc0801000
CONFIG_SPL_MMC=y
CONFIG_SPL_SYS_MALLOC_F_LEN=0x8000
CONFIG_SPL_SIZE_LIMIT=0x72F00
CONFIG_SPL=y
CONFIG_SPL_FS_FAT=y
CONFIG_SPL_SPI_FLASH_SUPPORT=y
CONFIG_SPL_SPI=y
CONFIG_SYS_LOAD_ADDR=0x102000000
CONFIG_TARGET_SPACEMIT_K3=y
CONFIG_SPL_OPENSBI_LOAD_ADDR=0x100000000
CONFIG_ARCH_RV64I=y
CONFIG_RISCV_SMODE=y
# CONFIG_RISCV_ISA_C is not set
# CONFIG_SPL_SMP is not set
CONFIG_ENV_VARS_UBOOT_CONFIG=y
CONFIG_HAS_CUSTOM_SYS_INIT_SP_ADDR=y
CONFIG_CUSTOM_SYS_INIT_SP_ADDR=0x102300000
CONFIG_STACK_SIZE=0x100000
# CONFIG_ANDROID_BOOT_IMAGE is not set
CONFIG_FIT=y
# CONFIG_FIT_FULL_CHECK is not set
CONFIG_SPL_LOAD_FIT_ADDRESS=0x110000000
CONFIG_SPL_FIT_IMAGE_POST_PROCESS=y
# CONFIG_BOOTSTD is not set
# CONFIG_LEGACY_IMAGE_FORMAT is not set
CONFIG_SUPPORT_RAW_INITRD=y
CONFIG_BOOTDELAY=3
CONFIG_USE_BOOTCOMMAND=y
CONFIG_BOOTCOMMAND="booti 0x120000000 - 0x128000000"
CONFIG_LOGLEVEL=7
CONFIG_LOG=y
CONFIG_LOG_MAX_LEVEL=8
CONFIG_LOG_DEFAULT_LEVEL=6
CONFIG_LOGF_FILE=y
CONFIG_LOGF_LINE=y
CONFIG_LOGF_FUNC=y
CONFIG_SPL_LOG=y
CONFIG_SPL_LOG_MAX_LEVEL=6
CONFIG_LOG_ERROR_RETURN=y
CONFIG_DISPLAY_CPUINFO=y
CONFIG_DISPLAY_BOARDINFO=y
CONFIG_EVENT=y
CONFIG_EVENT_DYNAMIC=y
CONFIG_MISC_INIT_R=y
CONFIG_SPL_MAX_SIZE=0x6AF00
CONFIG_SPL_PAD_TO=0x0
CONFIG_SPL_BSS_START_ADDR=0xc0874000
CONFIG_SPL_BSS_MAX_SIZE=0x3000
# CONFIG_SPL_SHARES_INIT_SP_ADDR is not set
CONFIG_SPL_STACK=0xc0880000
CONFIG_SYS_SPL_MALLOC=y
CONFIG_HAS_CUSTOM_SPL_MALLOC_START=y
CONFIG_CUSTOM_SYS_SPL_MALLOC_ADDR=0x104000000
CONFIG_SYS_SPL_MALLOC_SIZE=0x2000000
CONFIG_SYS_MMCSD_RAW_MODE_U_BOOT_USE_PARTITION=y
CONFIG_SYS_MMCSD_RAW_MODE_U_BOOT_PARTITION=0x4
CONFIG_SPL_ENV_SUPPORT=y
CONFIG_SPL_FS_LOAD_PAYLOAD_NAME="opensbi.itb"
CONFIG_SPL_I2C=y
CONFIG_SYS_MMCSD_FS_BOOT_PARTITION=4
CONFIG_SPL_MTD_SUPPORT=y
CONFIG_SPL_DM_SPI_FLASH=y
CONFIG_SPL_DM_RESET=y
CONFIG_SPL_POWER=y
CONFIG_SPL_RAM_SUPPORT=y
CONFIG_SPL_RAM_DEVICE=y
CONFIG_SPL_SPI_FLASH_MTD=y
CONFIG_SPL_MTD_LOAD=y
CONFIG_SYS_LOAD_IMAGE_PARTITION_NAME="opensbi"
CONFIG_SPL_USB_GADGET=y
CONFIG_SPL_FASTBOOT_LOAD=y
CONFIG_SPL_USB_SDP_SUPPORT=y
CONFIG_SPL_OPENSBI_SCRATCH_OPTIONS=0x0
CONFIG_HUSH_PARSER=y
CONFIG_SYS_CBSIZE=256
CONFIG_SYS_PBSIZE=276
CONFIG_CMD_TLV_EEPROM=y
# CONFIG_BOOTM_NETBSD is not set
# CONFIG_BOOTM_PLAN9 is not set
# CONFIG_BOOTM_RTEMS is not set
# CONFIG_BOOTM_VXWORKS is not set
CONFIG_SYS_BOOTM_LEN=0x4000000
# CONFIG_CMD_ELF is not set
CONFIG_CMD_MD5SUM=y
# CONFIG_CMD_LZMADEC is not set
# CONFIG_CMD_UNLZ4 is not set
CONFIG_CMD_GPIO=y
CONFIG_CMD_GPT=y
CONFIG_CMD_GPT_RENAME=y
CONFIG_CMD_I2C=y
CONFIG_CMD_MMC=y
CONFIG_CMD_BKOPS_ENABLE=y
CONFIG_CMD_MTD=y
CONFIG_CMD_PART=y
CONFIG_CMD_PCI=y
CONFIG_CMD_DHCP=y
CONFIG_CMD_TFTPPUT=y
CONFIG_SYS_DISABLE_AUTOLOAD=y
CONFIG_CMD_PING=y
# CONFIG_CMD_BLOCK_CACHE is not set
CONFIG_CMD_SYSBOOT=y
CONFIG_CMD_FAT=y
CONFIG_CMD_FS_GENERIC=y
CONFIG_CMD_MTDPARTS=y
CONFIG_MTDIDS_DEFAULT="nor0=spi-flash"
CONFIG_MTDPARTS_DEFAULT="spi-flash:128K@0(bootinfo),512K@128K(fsbl),64K@640K(env),1M@704K(esos),384K@1728K(opensbi),-@2112K(uboot)"
CONFIG_SPACEMIT_FLASH=y
CONFIG_SPL_FASTBOOT=y
# CONFIG_DOS_PARTITION is not set
CONFIG_PARTITION_TYPE_GUID=y
CONFIG_OF_BOARD=y
CONFIG_OF_OMIT_DTB=y
CONFIG_MULTI_DTB_FIT=y
CONFIG_SYS_RELOC_GD_ENV_ADDR=y
CONFIG_ARP_TIMEOUT=500
CONFIG_NET_RETRY_COUNT=50
CONFIG_NET_RANDOM_ETHADDR=y
CONFIG_IP_DEFRAG=y
CONFIG_NET_MAXDEFRAG=65535
CONFIG_REGMAP=y
CONFIG_SPL_CLK=y
CONFIG_SPL_CLK_CCF=y
CONFIG_SPACEMIT_K3_CCU=y
CONFIG_USB_FUNCTION_FASTBOOT=y
CONFIG_FASTBOOT_BUF_ADDR=0x110000000
CONFIG_FASTBOOT_BUF_SIZE=0x10000000
CONFIG_FASTBOOT_FLASH=y
CONFIG_FASTBOOT_MULTI_FLASH_OPTION=y
CONFIG_FASTBOOT_FLASH_MMC_DEV=2
CONFIG_FASTBOOT_SUPPORT_BLOCK_DEV=y
CONFIG_K1X_GPIO=y
CONFIG_DM_I2C=y
# CONFIG_SPL_DM_I2C is not set
CONFIG_SPL_SYS_I2C_LEGACY=y
CONFIG_SYS_I2C_SPACEMIT=y
CONFIG_SPL_SYS_I2C_SPACEMIT=y
# CONFIG_INPUT is not set
CONFIG_MISC=y
CONFIG_I2C_EEPROM=y
CONFIG_SYS_I2C_EEPROM_ADDR=0x50
CONFIG_FS_LOADER=y
CONFIG_SPL_FS_LOADER=y
CONFIG_MMC=y
CONFIG_SUPPORT_EMMC_BOOT=y
CONFIG_MMC_IO_VOLTAGE=y
CONFIG_MMC_UHS_SUPPORT=y
CONFIG_MMC_HS400_ES_SUPPORT=y
CONFIG_MMC_HS400_SUPPORT=y
# CONFIG_MMC_VERBOSE is not set
CONFIG_MMC_SDHCI=y
CONFIG_MMC_SDHCI_ADMA=y
CONFIG_MMC_SDHCI_K1X=y
CONFIG_DM_MTD=y
CONFIG_SPI_FLASH_GIGADEVICE=y
CONFIG_SPI_FLASH_WINBOND=y
CONFIG_SPI_FLASH_XMC=y
CONFIG_SPI_FLASH_MTD=y
CONFIG_DWC_ETH_QOS=y
CONFIG_NVME_PCI=y
CONFIG_PCI=y
CONFIG_PCIE_DW_SPACEMIT=y
CONFIG_PINCTRL=y
CONFIG_PINCTRL_SINGLE=y
CONFIG_POWER_DOMAIN=y
CONFIG_K3_POWER_DOMAIN=y
CONFIG_DM_PMIC=y
# CONFIG_SPL_DM_PMIC is not set
CONFIG_PMIC_SPM8XX=y
CONFIG_DM_REGULATOR=y
CONFIG_DM_REGULATOR_SPM8XX=y
CONFIG_SPL_SPACEMIT_POWER=y
# CONFIG_RAM_SIFIVE is not set
CONFIG_SPL_REMOTEPROC_K3_PROC=y
CONFIG_RESET_SPACEMIT_K3=y
CONFIG_SYS_NS16550=y
CONFIG_SYS_NS16550_IER=0x40
CONFIG_SPI=y
CONFIG_K1X_QSPI=y
CONFIG_K1X_SPI=y
CONFIG_TIMER_EARLY=y
CONFIG_USB=y
CONFIG_DM_USB_GADGET=y
CONFIG_SPL_DM_USB_GADGET=y
CONFIG_USB_DWC3=y
CONFIG_USB_DWC3_GENERIC=y
CONFIG_SPL_USB_DWC3_GENERIC=y
CONFIG_USB_GADGET=y
CONFIG_USB_GADGET_VENDOR_NUM=0x361c
CONFIG_USB_GADGET_PRODUCT_NUM=0x1001
CONFIG_WDT=y
# CONFIG_REGEX is not set
# CONFIG_SPL_SHA1 is not set
# CONFIG_SPL_SHA256 is not set
CONFIG_SPL_LZO=y
# CONFIG_EFI_LOADER is not set
```

## drivers/espi/Kconfig
```kconfig
menuconfig ESPI
	bool "Enhanced SPI (eSPI) support"
	help
	  Enable support for Enhanced Serial Peripheral Interface (eSPI).
	  eSPI is designed to replace the Low Pin Count (LPC) bus for
	  communication between processors and embedded controllers.
if ESPI
config DM_ESPI
	bool "Enable Driver Model for eSPI drivers"
	depends on DM
	help
	  Enable driver model for eSPI. The eSPI interface provides
	  methods to access eSPI buses and attached devices. The uclass
	  interface is defined in include/espi.h. This allows eSPI
	  controllers to be configured through device tree properties.

config ESPI_SPACEMIT_K3
	bool "SpacemiT K3 eSPI controller"
	depends on DM_ESPI
	help
	  Enable the SpacemiT K3 eSPI controller driver. This driver can be
	  used to access eSPI devices on platforms embedding this SpacemiT
	  IP core. Supports Peripheral, VWire, OOB, and Flash channels.

endif

menuconfig SPL_ESPI
	bool "Enhanced SPI (eSPI) support in SPL"
	depends on SPL_DM
	help
	  Enable support for Enhanced Serial Peripheral Interface (eSPI) in SPL.
	  This option provides basic eSPI initialization in SPL stage, which is
	  useful for early hardware initialization before U-Boot proper.
	  Only essential initialization functions are included in SPL to minimize
	  code size. Advanced features like VWire, OOB, and Flash operations are
	  excluded from SPL build.

if SPL_ESPI

config SPL_DM_ESPI
	bool
	default y
	help
	  Enable driver model for eSPI in SPL. This is automatically enabled
	  when SPL_ESPI is selected.

config SPL_ESPI_SPACEMIT_K3
	bool "SpacemiT K3 eSPI controller in SPL"
	depends on SPL_ESPI
	default y if ESPI_SPACEMIT_K3
	help
	  Enable the SpacemiT K3 eSPI controller driver in SPL. This provides
	  basic eSPI bus initialization in SPL stage. Only core initialization
	  functions are included to minimize SPL size. Advanced operations like
	  VWire, OOB, and Flash access are not available in SPL.

endif
```

## drivers/mtd/nand/spi/Kconfig
```kconfig
menuconfig MTD_SPI_NAND
	bool "SPI NAND device Support"
	depends on DM_MTD && DM_SPI
	select MTD_NAND_CORE
	select SPI_MEM
	help
	  This is the framework for the SPI NAND device drivers.

if MTD_SPI_NAND

config SPI_NAND_GIGADEVICE
	bool "GigaDevice spi nand flash support"
	default n
	help
	 Enable this if want to use GigaDevice spi nand flash.

config SPI_NAND_MACRONIX
	bool "Macronix spi nand flash support"
	default n
	help
	 Enable this if want to use Macronix spi nand flash.

config SPI_NAND_MICRON
	bool "Micron spi nand flash support"
	default n
	help
	 Enable this if want to use Micron spi nand flash.

config SPI_NAND_TOSHIBA
	bool "Toshiba spi nand flash support"
	default n
	help
	 Enable this if want to use TOSHIBA spi nand flash.

config SPI_NAND_WINBOND
	bool "Winbond spi nand flash support"
	default n
	help
	 Enable this if want to use Winbond spi nand flash.

endif # MTD_SPI_NAND
```

## drivers/phy/spacemit/Kconfig
```kconfig
config PHY_SPACEMIT_K1X_USB2
	bool "Spacemit k1-x USB2 PHY Driver"
	depends on PHY
	help
	  Support for Spacemit k1-x USB 2 PHY

config SPL_PHY_SPACEMIT_K1X_USB2
	bool "Spacemit k1-x USB2 PHY Driver in SPL"
	depends on PHY
	help
	  Support for Spacemit k1-x USB 2 PHY

config PHY_SPACEMIT_K1X_COMBPHY
	tristate "Spacemit K1-x USB3&PCIE combo PHY driver"
	depends on PHY
	help
	  USB3 and PCIE Combo PHY Support for Spacemit k1-x Soc

config SPL_PHY_SPACEMIT_K1X_COMBPHY
	tristate "Spacemit K1-x USB3&PCIE combo PHY driver in SPL"
	depends on PHY
	help
	  USB3 and PCIE Combo PHY Support for Spacemit k1-x Soc

config PHY_SPACEMIT_K3_USB3
	tristate "Spacemit K3 USB3/PCIE/Combo PHY driver"
	depends on PHY
	help
	  USB3 and PCIE Combo PHY Support for Spacemit k3 Soc

config SPL_PHY_SPACEMIT_K3_USB3
	tristate "Spacemit K3 USB3/PCIE/Combo PHY driver in SPL"
	depends on PHY
	help
	  USB3 and PCIE Combo PHY Support for Spacemit k3 Soc

config PHY_SPACEMIT_PCIE
	tristate "Spacemit soc PCIe PHY driver"
	depends on PHY
	help
	  PCIe PHY Support for Spacemit Soc

config SPL_PHY_SPACEMIT_PCIE
	tristate "Spacemit soc PCIe PHY driver in SPL"
	depends on PHY
	help
	  PCIe PHY Support for Spacemit Soc
```

## drivers/usb/tcpm/Kconfig
```kconfig
# SPDX-License-Identifier: GPL-2.0

config TYPEC_TCPM
	tristate "USB Type-C Port Controller Manager"
	depends on DM
	help
	  The Type-C Port Controller Manager provides a USB PD and USB Type-C
	  state machine for use with Type-C Port Controllers.

config TYPEC_FUSB301
	tristate "Fairchild FUSB301 Type-C chip driver"
	depends on DM && DM_I2C && TYPEC_TCPM
	help
	  The Fairchild FUSB301 Type-C chip driver that works with
	  Type-C Port Controller Manager to provide USB Type-C functionalities.

config TYPEC_SWITCH
	tristate "USB Type-C Port Switch"
	depends on DM
	help
	  The Type-C Port Switch provides a USB Type-C Switch Ops
	  for orientation.

config TYPEC_SWITCH_GPIO_SBU
	tristate "Generic GPIO based SBU Switch for USB Type-C applications"
	depends on DM && TYPEC_SWITCH
	help
	  The GPIO based switch for managing the connected state and
	  the swapping of the SBU lines in a Type-C port.
```
