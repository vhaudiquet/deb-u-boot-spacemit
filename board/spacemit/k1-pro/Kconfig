## board/spacemit/k1-pro/Kconfig
```kconfig
if TARGET_SPACEMIT_K1PRO

config SYS_BOARD
	default "k1-pro"

config SYS_VENDOR
	default "spacemit"

config SYS_CPU
	default "x60"

config SYS_CONFIG_NAME
	default "k1-pro"

config SYS_TEXT_BASE
	default 0x81200000 if SPL
	default 0x80000000 if !RISCV_SMODE
	default 0x80200000 if RISCV_SMODE && ARCH_RV64I
	default 0x80400000 if RISCV_SMODE && ARCH_RV32I

config SPL_TEXT_BASE
	default 0x20100000

config SPL_OPENSBI_LOAD_ADDR
	hex
	default 0x21000000

config BOARD_SPECIFIC_OPTIONS # dummy
	def_bool y
	select SPACEMIT_X60
	imply AHCI
	imply SMP
	imply BOARD_LATE_INIT
	imply PCI_INIT_R
	imply SPL_RAM_SUPPORT
	imply SPL_RAM_DEVICE
	imply CMD_PCI
	imply CMD_POWEROFF
	imply CMD_SBI
	imply CMD_SCSI
	imply CMD_PING
	imply CMD_EXT2
	imply CMD_EXT4
	imply CMD_FAT
	imply CMD_FS_GENERIC
	imply DOS_PARTITION
	imply ISO_PARTITION
	imply EFI_PARTITION
	imply SCSI_AHCI
	imply AHCI_PCI
	imply E1000
	imply NVME
	imply PCI
	imply PCIE_ECAM_GENERIC
	imply SCSI
	imply DM_SCSI
	imply SYS_NS16550
	imply SIFIVE_SERIAL
	imply HTIF_CONSOLE if 64BIT
	imply SYSRESET
	imply SYSRESET_CMD_POWEROFF
	imply SYSRESET_SYSCON
	imply VIRTIO_MMIO
	imply VIRTIO_PCI
	imply VIRTIO_NET
	imply VIRTIO_BLK
	imply MTD_NOR_FLASH
	imply CFI_FLASH
	imply OF_HAS_PRIOR_STAGE

choice
	prompt "product board"
	default K1_PRO_BOARD_QEMU

config K1_PRO_BOARD_QEMU
	bool "k1-pro board qemu"
	help
	  k1-pro board is qemu.

config K1_PRO_BOARD_FPGA
	bool "k1-pro board fpga"
	help
	  k1-pro board is fpga.

config K1_PRO_BOARD_SIMULATION
	bool "k1-pro board simulation"
	help
	  k1-pro board is simulation.
endchoice

endif
```

## board/spacemit/k3/Kconfig
```kconfig
if TARGET_SPACEMIT_K3

config SYS_BOARD
	default "k3"

config SYS_VENDOR
	default "spacemit"

config SYS_CPU
	default "x100"

config SYS_CONFIG_NAME
	default "k3"

config SYS_TEXT_BASE
	default 0x81200000 if SPL
	default 0x80000000 if !RISCV_SMODE
	default 0x80200000 if RISCV_SMODE

config SPL_TEXT_BASE
	default 0x20100000

config SPL_OPENSBI_LOAD_ADDR
	hex
	default 0x21000000

config FDT_ADD_MEMORY_NODE
	bool "enable to add memory node to fdt before boot kernel"
	default n

config SPACEMIT_BUILD_BIN
       bool "build fsbl.bin for spacemit image"
       default n

config BOARD_SPECIFIC_OPTIONS # dummy
	def_bool y
	select SPACEMIT_X100
	imply BOARD_LATE_INIT

choice
	prompt "product board"
	default K3_BOARD_FPGA

config K3_BOARD_FPGA
	bool "k3 board fpga"
	help
	  k3 board is fpga.

config K3_BOARD_ASIC
	bool "k3 board asic"
	help
	  k3 board is asic.

endchoice

config BOOT_FROM_USB_DISK
	default n
	bool "boot using usb disk"
	help
		use USB disk to boot

choice
	prompt "DDR quick boot framework"
	default DDR_TRAINING_UPDATE_FSBL

config DDR_TRAINING_SAVE_RESTORE
	bool "save DDR training info to local storage"
	help
		In order to support quick boot, need save DDR training info during
		fisrt boot, and restore it during next boot.

config DDR_TRAINING_UPDATE_FSBL
	depends on !CONFIG_RSA_VERIFY
	bool "write DDR training info back to fsbl image"
	help
		In order to support quick boot, update DDR training info to fsbl
		image during image flash process, then training info is available
		during normal boot.

endchoice

endif
```

## board/spacemit/k3/configs/uboot_fdt.its
```
/dts-v1/;
/ {
	description = "U-boot FIT image for k3";
	#address-cells = <2>;
	fit,fdt-list = "of-list";

	images {
		uboot {
			description = "U-Boot";
			type = "standalone";
			os = "u-boot";
			arch = "riscv";
			compression = "none";
			load = <0x1 0x02000000>;
			data = /incbin/("../u-boot-nodtb.bin");
			hash-1 {
				algo = "crc32";
			};
		};

		fdt_1 {
			description = "k3_fpga.dtb";
			type = "flat_dt";
			compression = "none";
			data = /incbin/("../dtb/k3_fpga_1x1.dtb");
			hash-1 {
				algo = "crc32";
			};
		};

		fdt_2 {
			description = "k3_evb.dtb";
			type = "flat_dt";
			compression = "none";
			data = /incbin/("../dtb/k3_evb.dtb");
			hash-1 {
				algo = "crc32";
			};
		};

		fdt_3 {
			description = "k3_deb1.dtb";
			type = "flat_dt";
			compression = "none";
			data = /incbin/("../dtb/k3_deb1.dtb");
			hash-1 {
				algo = "crc32";
			};
		};

		fdt_4 {
			description = "k3_com260.dtb";
			type = "flat_dt";
			compression = "none";
			data = /incbin/("../dtb/k3_com260.dtb");
			hash-1 {
				algo = "crc32";
			};
		};

		fdt_5 {
			description = "k3-deepcomputing-fml13v05.dtb";
			type = "flat_dt";
			compression = "none";
			data = /incbin/("../dtb/k3-deepcomputing-fml13v05.dtb");
			hash-1 {
				algo = "crc32";
			};
		};

		fdt_6 {
			description = "k3_com260_kit_v02.dtb";
			type = "flat_dt";
			compression = "none";
			data = /incbin/("../dtb/k3_com260_kit_v02.dtb");
			hash-1 {
				algo = "crc32";
			};
		};

		fdt_7 {
			description = "k3_gemini_c0.dtb";
			type = "flat_dt";
			compression = "none";
			data = /incbin/("../dtb/k3_gemini_c0.dtb");
			hash-1 {
				algo = "crc32";
			};
		};

		fdt_8 {
			description = "k3_gemini_c1.dtb";
			type = "flat_dt";
			compression = "none";
			data = /incbin/("../dtb/k3_gemini_c1.dtb");
			hash-1 {
				algo = "crc32";
			};
		};

		fdt_9 {
			description = "k3_evb2-1.dtb";
			type = "flat_dt";
			compression = "none";
			data = /incbin/("../dtb/k3_evb2-1.dtb");
			hash-1 {
				algo = "crc32";
			};
		};

		fdt_10 {
			description = "k3_evb2-2.dtb";
			type = "flat_dt";
			compression = "none";
			data = /incbin/("../dtb/k3_evb2-2.dtb");
			hash-1 {
				algo = "crc32";
			};
		};

		fdt_11 {
			description = "k3-pico-itx.dtb";
			type = "flat_dt";
			compression = "none";
			data = /incbin/("../dtb/k3-pico-itx.dtb");
			hash-1 {
				algo = "crc32";
			};
		};

		fdt_12 {
			description = "k3_BS01DCMA.dtb";
			type = "flat_dt";
			compression = "none";
			data = /incbin/("../dtb/k3_BS01DCMA.dtb");
			hash-1 {
				algo = "crc32";
			};
		};

		fdt_13 {
			description = "k3_com260_ifx.dtb";
			type = "flat_dt";
			compression = "none";
			data = /incbin/("../dtb/k3_com260_ifx.dtb");
			hash-1 {
				algo = "crc32";
			};
		};

		fdt_14 {
			description = "k3_com260_tq.dtb";
			type = "flat_dt";
			compression = "none";
			data = /incbin/("../dtb/k3_com260_tq.dtb");
			hash-1 {
				algo = "crc32";
			};
		};

		fdt_15 {
			description = "k3_com260_ifx2.dtb";
			type = "flat_dt";
			compression = "none";
			data = /incbin/("../dtb/k3_com260_ifx2.dtb");
			hash-1 {
				algo = "crc32";
			};
		};
	};

	configurations {
		default = "conf_3";
		conf_1 {
			description = "k3_fpga";
			loadables = "uboot";
			fdt = "fdt_1";
		};

		conf_2 {
			description = "k3_evb";
			loadables = "uboot";
			fdt = "fdt_2";
		};

		conf_3 {
			description = "k3_deb1";
			loadables = "uboot";
			fdt = "fdt_3";
		};

		conf_4 {
			description = "k3_com260";
			loadables = "uboot";
			fdt = "fdt_4";
		};

		conf_5 {
			description = "k3-deepcomputing-fml13v05";
			loadables = "uboot";
			fdt = "fdt_5";
		};

		conf_6 {
			description = "k3_com260_kit_v02";
			loadables = "uboot";
			fdt = "fdt_6";
		};

		conf_7 {
			description = "k3_gemini_c0";
			loadables = "uboot";
			fdt = "fdt_7";
		};

		conf_8 {
			description = "k3_gemini_c1";
			loadables = "uboot";
			fdt = "fdt_8";
		};

		conf_9 {
			description = "k3_evb2-1";
			loadables = "uboot";
			fdt = "fdt_9";
		};

		conf_10 {
			description = "k3_evb2-2";
			loadables = "uboot";
			fdt = "fdt_10";
		};

		conf_11 {
			description = "k3-pico-itx";
			loadables = "uboot";
			fdt = "fdt_11";
		};

		conf_12 {
			description = "k3_BS01DCMA";
			loadables = "uboot";
			fdt = "fdt_12";
		};

		conf_13 {
			description = "k3_com260_ifx";
			loadables = "uboot";
			fdt = "fdt_13";
		};

		conf_14 {
			description = "k3_com260_tq";
			loadables = "uboot";
			fdt = "fdt_14";
		};

		conf_15 {
			description = "k3_com260_ifx2";
			loadables = "uboot";
			fdt = "fdt_15";
		};
	};
};
```

## board/spacemit/k3/configs/uboot_fdt_sign.its
```
/dts-v1/;
/ {
	description = "Signed U-boot FIT image for k3";
	#address-cells = <2>;
	fit,fdt-list = "of-list";

	images {
		uboot {
			description = "U-Boot";
			type = "standalone";
			os = "u-boot";
			arch = "riscv";
			compression = "none";
			load = <0x1 0x02000000>;
			data = /incbin/("../u-boot-nodtb.bin");
			hash {
				algo = "sha256";
			};
		};
		fdt_1 {
			description = "k3_fpga_1x1";
			type = "flat_dt";
			compression = "none";
			data = /incbin/("../dtb/k3_fpga_1x1.dtb");
			hash {
				algo = "sha256";
			};
		};
	};
	configurations {
		default = "conf_1";
		conf_1 {
			description = "k3_fpga";
			loadables = "uboot";
			fdt = "fdt_1";
			signature {
				algo = "sha256,rsa2048";
				key-name-hint = "uboot_key_prv";
				sign-images = "loadables", "fdt";
			};
		};
	};
};
```

## configs/k1-pro_fpga_1x4_defconfig
```kconfig
CONFIG_RISCV=y
CONFIG_SYS_TEXT_BASE=0xa000200000
CONFIG_SYS_MALLOC_LEN=0x800000
CONFIG_SYS_MALLOC_F_LEN=0x2000
CONFIG_NR_DRAM_BANKS=1
CONFIG_ENV_SIZE=0x4000
CONFIG_DM_GPIO=y
CONFIG_SPL_DM_SPI=y
CONFIG_DEFAULT_DEVICE_TREE="k1-pro_fpga_1x4"
CONFIG_SPL_TEXT_BASE=0xA010000080
CONFIG_SPL_MMC=y
CONFIG_SPL_SIZE_LIMIT=0x20000
CONFIG_SPL=y
CONFIG_SPL_FS_FAT=y
CONFIG_SPL_SPI_FLASH_SUPPORT=y
CONFIG_SPL_SPI=y
CONFIG_SYS_LOAD_ADDR=0x0
CONFIG_BUILD_TARGET=""
CONFIG_TARGET_SPACEMIT_K1PRO=y
CONFIG_SPL_OPENSBI_LOAD_ADDR=0xA000000000
CONFIG_K1_PRO_BOARD_FPGA=y
CONFIG_ARCH_RV64I=y
CONFIG_RISCV_SMODE=y
CONFIG_LOCALVERSION="spacemit"
CONFIG_HAS_CUSTOM_SYS_INIT_SP_ADDR=y
CONFIG_CUSTOM_SYS_INIT_SP_ADDR=0x2f940000
CONFIG_FIT=y
CONFIG_SPL_LOAD_FIT_ADDRESS=0xa000200000
# CONFIG_BOOTSTD_BOOTCOMMAND is not set
CONFIG_SUPPORT_RAW_INITRD=y
CONFIG_BOOTDELAY=0
CONFIG_AUTOBOOT_KEYED=y
CONFIG_AUTOBOOT_STOP_STR="s"
CONFIG_USE_BOOTCOMMAND=y
CONFIG_BOOTCOMMAND="dhcp"
CONFIG_DISPLAY_CPUINFO=y
CONFIG_DISPLAY_BOARDINFO=y
CONFIG_SPL_FRAMEWORK_BOARD_INIT_F=y
CONFIG_SPL_MAX_SIZE=0x20000
CONFIG_SPL_PAD_TO=0x0
CONFIG_SPL_BSS_START_ADDR=0xA010020000
CONFIG_SPL_BSS_MAX_SIZE=0x1000
CONFIG_SYS_SPL_MALLOC=y
CONFIG_SYS_SPL_MALLOC_SIZE=0x500000
CONFIG_SYS_MMCSD_RAW_MODE_U_BOOT_USE_PARTITION=y
CONFIG_SYS_MMCSD_RAW_MODE_U_BOOT_PARTITION=0x0
CONFIG_SYS_MMCSD_FS_BOOT_PARTITION=0
CONFIG_SPL_DM_SPI_FLASH=y
CONFIG_SPL_DM_RESET=y
# CONFIG_SPL_RAM_SUPPORT is not set
CONFIG_SPL_OPENSBI_SCRATCH_OPTIONS=0x0
CONFIG_HUSH_PARSER=y
CONFIG_SYS_CBSIZE=256
CONFIG_SYS_PBSIZE=276
# CONFIG_CMD_CPU is not set
CONFIG_SYS_BOOTM_LEN=0xa000000
CONFIG_CMD_GPIO=y
CONFIG_CMD_GPIO_READ=y
CONFIG_CMD_MMC=y
CONFIG_CMD_BKOPS_ENABLE=y
CONFIG_CMD_MMC_SWRITE=y
CONFIG_CMD_MTD=y
CONFIG_CMD_PART=y
CONFIG_CMD_USB=y
CONFIG_CMD_DHCP=y
CONFIG_SYS_DISABLE_AUTOLOAD=y
CONFIG_CMD_PXE=y
CONFIG_CMD_SYSBOOT=y
# CONFIG_OF_OMIT_DTB is not set
CONFIG_ENV_IS_IN_FAT=y
CONFIG_ENV_FAT_DEVICE_AND_PART="0:"
CONFIG_ENV_FAT_FILE="env.bin"
CONFIG_SYS_MMC_ENV_PART=1
CONFIG_PROT_UDP=y
CONFIG_NET_RANDOM_ETHADDR=y
CONFIG_IP_DEFRAG=y
CONFIG_KEEP_SERVERADDR=y
CONFIG_BOOTP_SERVERIP=y
CONFIG_SPL_CLK=y
CONFIG_SPL_CLK_CCF=y
CONFIG_CLK_CCF=y
CONFIG_CLK_K1_CCU=y
CONFIG_DMA=y
CONFIG_DMA_CHANNELS=y
CONFIG_AXI_DMA=y
CONFIG_USB_FUNCTION_FASTBOOT=y
CONFIG_FASTBOOT_BUF_ADDR=0xA000070000
CONFIG_DWAPB_GPIO=y
CONFIG_DM_I2C=y
CONFIG_SYS_I2C_DW=y
CONFIG_MISC=y
# CONFIG_SPL_MISC is not set
CONFIG_I2C_EEPROM=y
CONFIG_MMC=y
CONFIG_MMC_SDHCI=y
CONFIG_MMC_SDHCI_ADMA=y
CONFIG_SPL_MMC_SDHCI_ADMA=y
CONFIG_MMC_SDHCI_SPACEMIT=y
CONFIG_DM_MTD=y
# CONFIG_MTD_NOR_FLASH is not set
CONFIG_SYS_MAX_FLASH_BANKS=2
CONFIG_MTD_SPI_NAND=y
CONFIG_SPI_FLASH_STMICRO=y
CONFIG_SPI_FLASH_MTD=y
CONFIG_PHY_MARVELL=y
CONFIG_DWC_ETH_QOS=y
CONFIG_DWC_ETH_QOS_SPACEMIT=y
# CONFIG_E1000 is not set
CONFIG_ETH_DESIGNWARE=y
CONFIG_DW_ALTDESCRIPTOR=y
CONFIG_RMII=y
CONFIG_NVME_PCI=y
CONFIG_PCIE_DW_SPACEMIT=y
CONFIG_PINCTRL=y
CONFIG_PINCTRL_K1PRO=y
CONFIG_DM_RESET=y
CONFIG_RESET_SPACEMIT=y
CONFIG_SPI=y
CONFIG_DESIGNWARE_SPI=y
CONFIG_TIMER_EARLY=y
CONFIG_USB=y
CONFIG_DM_USB_GADGET=y
CONFIG_USB_XHCI_HCD=y
CONFIG_USB_XHCI_DWC3=y
CONFIG_USB_DWC2=y
CONFIG_USB_STORAGE=y
CONFIG_USB_GADGET=y
CONFIG_USB_GADGET_VENDOR_NUM=0x18D1
CONFIG_USB_GADGET_PRODUCT_NUM=0x0001
CONFIG_USB_GADGET_DWC2_OTG=y
CONFIG_USB_GADGET_DWC2_OTG_PHY_BUS_WIDTH_8=y
# CONFIG_SPL_SHA1 is not set
```
